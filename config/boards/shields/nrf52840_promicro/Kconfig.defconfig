## config/boards/shields/nrf52840_promicro/Kconfig.defconfig
```kconfig
if SHIELD_NRF52840_PROMICRO

config ZMK_KEYBOARD_NAME
	default "PM Test"

endif # SHIELD_NRF52840_PROMICRO
```

## config/boards/shields/nrf52840_promicro/Kconfig.shield
```kconfig
config SHIELD_NRF52840_PROMICRO
    def_bool $(shields_list_contains, NRF52840_PROMICRO)
```

## config/boards/shields/nrf52840_test/Kconfig.defconfig
```kconfig
if SHIELD_NRF52840_TEST

config ZMK_KEYBOARD_NAME
	default "nRF52840-DK Test"

endif # SHIELD_NRF52840_TEST
```

## config/boards/shields/nrf52840_test/Kconfig.shield
```kconfig
config SHIELD_NRF52840_TEST
    def_bool $(shields_list_contains, NRF52840_TEST)
```
